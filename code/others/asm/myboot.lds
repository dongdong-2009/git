OUTPUT_ARCH(arm)
ENTRY(_start)          /*指定程序入口地址，这里的地址要和汇编语言中的标号一致*/
SECTIONS{
	. = 0x30008000;    /*指定当前地址，即程序就搬运到此处运行了*/
	
	. = ALIGN(4);      /*每个段都要求4字节对齐，这样在32为系统里面运行的快*/
	.text :
	{
	start.o(.text)     /*由汇编start.s文件编写出来的文件存放在代码段的最前面*/
	*(.text)           /*剩下的所有文件依次存放*/
	}
	
	. = ALIGN(4);      /*每个段都要求4字节对齐，这样在32为系统里面运行的快*/
	.data :
	{
	*(.data)           /*所有的数据存放在数据段*/
	}
	
	. = ALIGN(4);      /*每个段都要求4字节对齐，这样在32为系统里面运行的快*/
	bss_start =.;     /*定义一个起始符号，为当前地址，直接定义即可*/
	.bss :
	{
	*(.bss)            /*.bss段主要用于存放全局变量和静态变量*/
	}
	bss_end =.;       /*定义一个结束的符号*/
}
